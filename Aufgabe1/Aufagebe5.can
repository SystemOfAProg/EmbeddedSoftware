/* ------- Sendmodul --- begin generated Comment ----
| CAPL template for CANoe IL models
| ActiveX based generation
| Functionality is done in CANoe directly - you can add application code for this node
   ---------- end generated Comment---- */

variables
{
  //Please insert your code below this comment
  message Generator_Nachricht msg1;
  int counter;
}

on key 's'{
  output(msg1);
}

on envVar sendMsg{
  if(@sendMsg%2 == 1){
    output(msg1);
    write("%d", @sendMsg);
  }
}

on preStart
{
  //Please insert your code below this comment
  
}

on start
{
  
}

on stopMeasurement
{
  //Please insert your code below this comment
  
}

