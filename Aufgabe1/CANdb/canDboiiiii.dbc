VERSION ""

NS_ :

BS_:

BU_:

BO_ 66 recv1_Nachricht: 2 Vector__XXX
 SG_ Signal4 : 8|8@1- (1,0) [0|0] "" Vector__XXX
 SG_ Signal3 : 0|8@1- (1,0) [0|0] "" Vector__XXX

BO_ 291 Generator_Nachricht: 2 Vector__XXX
 SG_ Signal2 : 8|8@1- (1,0) [0|0] "" Vector__XXX
 SG_ Signal1 : 0|8@1- (1,0) [0|0] "" Vector__XXX

EV_ sendMsg: 0 [0|0] "" 0 1 DUMMY_NODE_VECTOR0 Vector__XXX;

EV_ msgCounter: 0 [0|0] "" 0 2 DUMMY_NODE_VECTOR0 Vector__XXX;

BA_DEF_  "BusType" STRING ;
BA_DEF_DEF_  "BusType" "";
BA_ "BusType" "CAN";
