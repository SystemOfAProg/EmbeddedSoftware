/*@!Encoding:1252*/
variables
{
  message ACC_Brake acc_brake;
  message ACC_Accelerate acc_accelerate;
  message ACC_Slowdown acc_slowdown;
  message ACC_Error acc_error;
  //message ACC_State acc_state;
  message Display_State display_state;
  
  byte acc = 0;
  byte speed;
  byte speed_adjust;
  
  byte Lane_Car1;
  byte Lane_Car2;
  int  Speed_Car1;
  int  Speed_Car2;
  long distance_current;
  byte distance;
  
  byte Min_Distance = 10;
  byte Max_Distance = 30;
  int Max_Speed = 180;
  int Min_Speed = 30;
  int Off_Speed = 25;
  
  msTimer timer_display;
  const byte TIMEOUT_DISPLAY = 10;
}

on timer timer_display
{
  setTimer(timer_display, TIMEOUT_DISPLAY);

  sendSettings();
}

// Adjust Distance to value sent from display
on message Distance_Adjust
{
  if(acc==1) {
    if(this.Distance_Adjust >= Min_Distance && this.Distance_Adjust <= Max_Distance) {
     distance =  this.Distance_Adjust;
    } 
  }
}

// Adjust Speed from value sent from display
on message Speed_Adjust
{
  if(acc == 1) {
    if(this.Speed_Adjust >= Min_Speed && this.Speed_Adjust <= Max_Speed) {
      speed = this.Speed_Adjust;
    } 
  }
}

// Turn on ACC and adjust values if neccessary
on message ACC_State
{
  if(Speed_Car1 > Off_Speed && Speed_Car1 < Max_Speed) {
    acc = this.ACC_State;
    if(acc == 1) {
      initAcc(); 
    } 
  }
}

on message Manual_Brake
{
  acc = 0;
}

on message Manual_Accelerate
{
  acc = 0;
}

on message Car1_State
{
  Speed_Car1 = this.Speed_Car1_Current;
  if(this.Speed_Car1_Current < Off_Speed)
  {
    acc = 0;
    acc_error.ACC_Error = 1;
    output(acc_error);
  } else {
    Lane_Car1 = this.Lane_Car1_Current;    
  }
}

on message Car2_State
{
  Speed_Car2 = this.Speed_Car2_Current;
  Lane_Car2 = this.Lane_Car2_Current;
}

on message Distance_Current
{
  distance_current = this.Distance_Current;
  if(acc == 1) {
    if(Lane_Car1 == Lane_Car2) {
      if( (double)distance_current < ((((double)distance/10.0)*((double)speed/3.6))*100.0) ) {
        // Further check if dangerous situation, if yes send addBrake
        sendACCSlowdown();
        write("Slowdown");
      } else {
        if(Speed_Car1 < speed) {
          sendACCAccelerate();
          write("Accelerate");
        }
      }
    }
  }
}

on start
{
  setTimer(timer_display, TIMEOUT_DISPLAY);
  sendSettings();
}

// Set Distance to valid value and speed to current speed of Car 1
initAcc() {
  if(distance < Min_Distance || distance > Max_Distance) {
    distance = (Min_Distance + ((Max_Distance - Min_Distance) / 2));  
  }
  if(Speed_Car1 > Min_Speed && Speed_Car1 < Max_Speed) {
    speed = Speed_Car1;
  }
}

sendAccelerate() {
  
}

sendACCAccelerate()
{
  acc_accelerate.PedalTravel_ACC_Accelerate = 1;
  output(acc_accelerate);
}

sendBrake() {
  
}

sendACCBrake()
{
  acc_brake.PedalTravel_ACC_Brake = 1;
  output(acc_brake);
}

sendSlowdown() {
  
}

sendACCSlowdown()
{
  acc_slowdown.PedalTravel_ACC_Slowdown = 1;
  output(acc_slowdown);
}

sendSettings()
{
  display_state.ACC_State = acc;
  display_state.Speed_Adjusted = speed;
  display_state.Distance_Adjusted = distance;
  
  output(display_state);
}

